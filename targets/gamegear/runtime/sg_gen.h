/* Helpers for code generated by m0recomp --system gg (Game Gear).
 *
 * Generated regions keep the Z80 registers in machine.cpu and count time in
 * machine.cyc.  Cycles and refresh are added in batches (ADV) before every
 * point that observes them: device I/O, LD A,R, synchronisation, control
 * transfers.  SYNC polls the next device event at loop heads (every
 * instruction with SG_PRECISE); sg_event may run an interrupt handler, and
 * the region returns when control does not come back to pc.  Banked code
 * checks machine.page where the generator could not prove the mapping. */
#ifndef SG_GEN_H
#define SG_GEN_H
#include "gg.h"
#include "sg_config.h"

/* Paged ROM through the slot pointers; the first KiB is fixed. */
static inline __attribute__((always_inline)) uint8_t RD(uint16_t a) {
    if (a >= 0xc000) return machine.ram[a & 8191];
    if (a < 0x400 && !GG_CODEMASTERS) return machine.rom[a];
#if SG_CART_RAM
    if (a >= 0x8000 && (machine.ram_ctl & 8)) return gg_cart_byte(a);
#endif
    return gg_slot_read(a);
}
static inline __attribute__((always_inline)) void WR(uint16_t a, uint8_t v) { gg_write(a, v); }
static inline __attribute__((always_inline)) uint16_t RD16(uint16_t a) {
    return (uint16_t)(RD(a) | (RD((uint16_t)(a + 1)) << 8));
}
static inline __attribute__((always_inline)) void WR16(uint16_t a, uint16_t v) {
    WR(a, (uint8_t)v);
    WR((uint16_t)(a + 1), (uint8_t)(v >> 8));
}
/* The interpreter's instruction semantics, specialised on constant
 * operands, for the instructions not lowered by the generator. */
#define Z80_NATIVE_READ(c, a) ((void)(c), RD(a))
#define Z80_NATIVE_WRITE(c, a, v) ((void)(c), WR((a), (v)))
#define Z80_NATIVE_INLINE __attribute__((always_inline))
#include "z80_ops.h"

#define Z machine.cpu

static inline __attribute__((always_inline)) void PUSH(uint16_t v) {
    WR(--Z.sp, (uint8_t)(v >> 8));
    WR(--Z.sp, (uint8_t)v);
}
static inline __attribute__((always_inline)) uint16_t POP(void) {
    uint8_t lo = RD(Z.sp++);
    uint8_t hi = RD(Z.sp++);
    return (uint16_t)(lo | (hi << 8));
}

/* Out of line: one call instead of the inline expansion at every site
 * (flash).  Constant addresses are resolved by the generator instead. */
#define SG_HELPER static __attribute__((noinline, unused))
SG_HELPER uint8_t sg_rd(uint16_t a) { return RD(a); }
SG_HELPER void sg_wr(uint16_t a, uint8_t v) { WR(a, v); }
SG_HELPER uint16_t sg_rd16(uint16_t a) { return RD16(a); }
SG_HELPER void sg_wr16(uint16_t a, uint16_t v) { WR16(a, v); }
SG_HELPER void sg_push(uint16_t v) { PUSH(v); }
SG_HELPER uint16_t sg_pop(void) { return POP(); }
SG_HELPER void sg_add(uint8_t v) { z80_alu(&Z, 0, v); }
SG_HELPER void sg_adc(uint8_t v) { z80_alu(&Z, 1, v); }
SG_HELPER void sg_sub(uint8_t v) { z80_alu(&Z, 2, v); }
SG_HELPER void sg_sbc(uint8_t v) { z80_alu(&Z, 3, v); }
SG_HELPER void sg_and(uint8_t v) { z80_alu(&Z, 4, v); }
SG_HELPER void sg_xor(uint8_t v) { z80_alu(&Z, 5, v); }
SG_HELPER void sg_or(uint8_t v) { z80_alu(&Z, 6, v); }
SG_HELPER void sg_cp(uint8_t v) { z80_alu(&Z, 7, v); }
SG_HELPER uint8_t sg_inc(uint8_t v) { return z80_incdec(&Z, v, 0); }
SG_HELPER uint8_t sg_dec(uint8_t v) { return z80_incdec(&Z, v, 1); }
SG_HELPER uint8_t sg_rot0(uint8_t v) { return z80_rotate(&Z, v, 0); }
SG_HELPER uint8_t sg_rot1(uint8_t v) { return z80_rotate(&Z, v, 1); }
SG_HELPER uint8_t sg_rot2(uint8_t v) { return z80_rotate(&Z, v, 2); }
SG_HELPER uint8_t sg_rot3(uint8_t v) { return z80_rotate(&Z, v, 3); }
SG_HELPER uint8_t sg_rot4(uint8_t v) { return z80_rotate(&Z, v, 4); }
SG_HELPER uint8_t sg_rot5(uint8_t v) { return z80_rotate(&Z, v, 5); }
SG_HELPER uint8_t sg_rot6(uint8_t v) { return z80_rotate(&Z, v, 6); }
SG_HELPER uint8_t sg_rot7(uint8_t v) { return z80_rotate(&Z, v, 7); }
SG_HELPER void sg_daa(void) { z80_daa(&Z); }
/* ADC/SBC HL,rr, as in z80_execute */
SG_HELPER void sg_hl16(unsigned adc, uint16_t b) {
    uint16_t a = Z.hl;
    unsigned carry = Z.f & 1;
    uint32_t value = adc ? (uint32_t)a + b + carry : (uint32_t)a - b - carry;
    uint16_t r = (uint16_t)value;
    Z.f = (uint8_t)(((r >> 8) & (Z80_S | Z80_Y | Z80_X)) | (r ? 0 : Z80_Z) | (((a ^ b ^ r) & 0x1000) ? Z80_H : 0) |
                    ((value >> 16) & 1) | (adc ? 0 : Z80_N) | ((((adc ? ~(a ^ b) : (a ^ b)) & (a ^ r)) & 0x8000) ? Z80_PV : 0));
    Z.hl = r;
}
SG_HELPER void sg_neg(void) { Z.a = z80_add8(&Z, 0, Z.a, 0, 1); }
/* OUTI / OUTD, as in z80_execute (port C: the bus decodes the low byte) */
static inline __attribute__((always_inline)) void sg_outx(int delta) {
    const uint8_t v = RD(Z.hl);
    Z.b--;
    Z.hl = (uint16_t)(Z.hl + delta);
    gg_out(Z.c, v);
    const unsigned s = v + Z.l;
    Z.f = (uint8_t)(z80_sz(Z.b) | (v & 0x80 ? Z80_N : 0) | (s > 255 ? Z80_H | Z80_C : 0) | z80_parity((uint8_t)((s & 7) ^ Z.b)));
}
SG_HELPER void sg_outi(void) { sg_outx(1); }
SG_HELPER void sg_outd(void) { sg_outx(-1); }
/* Instructions without a generated lowering: the interpreter's semantics
 * (pc and refresh included), expanded once here. */
SG_HELPER unsigned sg_op(const z80_decoded_t *d) { return z80_execute(&Z, d); }

/* T-states and refresh counter */
#define ADV(cy, rf) do { \
        machine.cyc += (uint32_t)(cy); \
        Z.r = (uint8_t)((Z.r & 128) | ((Z.r + (rf)) & 127)); \
    } while (0)
#define CY(cy) (machine.cyc += (uint32_t)(cy))
#define EVT() ((int32_t)(machine.cyc - machine.next_evt) >= 0)
#define SYNC(pc) do { if (EVT() && sg_event(pc)) return; } while (0)
/* The host harness stops between frames (machine.stop); firmwares never do. */
#ifdef SG_GENERATED
#define SG_STOPPED() (machine.stop)
#else
#define SG_STOPPED() 0
#endif
/* EI takes effect after the next instruction: force a sync there. */
#define EI_DONE() do { Z.ei_delay = 0; if (Z.irq) machine.next_evt = machine.cyc; } while (0)

/* Region entry: a guest that recurses without returning (stack reset and
 * jump back to its main loop from a handler) would overflow the C stack;
 * below the limit the region returns at once with pc untouched and its
 * callers unwind to a dispatch loop, which resumes from pc. */
#if defined(__arm__)
#define SG_SP() ({ uintptr_t sp_; __asm__ volatile("mov %0, sp" : "=r"(sp_)); sp_; })
#else
#define SG_SP() ((uintptr_t)__builtin_frame_address(0))
#endif
#define ENTER() do { if (SG_SP() < sg_stack_limit) return; } while (0)

#define F_C 0x01
#define F_PV 0x04
#define F_Z 0x40
#define F_S 0x80

sg_fn sg_gen_lookup(uint16_t pc);
#endif
